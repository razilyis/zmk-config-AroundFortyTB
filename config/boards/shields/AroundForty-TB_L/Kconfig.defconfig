## config/boards/shields/AroundForty-TB_L/Kconfig.shield
```kconfig
config SHIELD_ARROUNDFORTY_TB_R
    def_bool $(shields_list_contains,AroundForty-TB_R)

config SHIELD_ARROUNDFORTY_TB_L
    def_bool $(shields_list_contains,AroundForty-TB_L)
```

## config/boards/shields/around_forty_tb/Kconfig.defconfig
```kconfig
if SHIELD_AROUND_FORTY_TB_RIGHT

config ZMK_KEYBOARD_NAME
    string
    default "AroundFortyTB_R"

config ZMK_SPLIT
    default y

config ZMK_SPLIT_ROLE_CENTRAL
    default y

endif

if SHIELD_AROUND_FORTY_TB_LEFT
config ZMK_KEYBOARD_NAME
    default "AroundFortyTB_L"

config ZMK_SPLIT
    default y

endif
```

## config/boards/shields/around_forty_tb/Kconfig.shield
```kconfig
config SHIELD_AROUND_FORTY_TB_RIGHT
    def_bool $(shields_list_contains,around_forty_tb_right)

config SHIELD_AROUND_FORTY_TB_LEFT
    def_bool $(shields_list_contains,around_forty_tb_left)
```
