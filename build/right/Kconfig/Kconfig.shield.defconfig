## build/right/Kconfig/Kconfig.shield.defconfig
```kconfig
osource "/Users/ryosaitoh/Desktop/git/zmk-rgbled-widget/boards/shields/*/Kconfig.defconfig"
osource "/Users/ryosaitoh/Desktop/git/modules/prospector-zmk-module/boards/shields/*/Kconfig.defconfig"
osource "/Users/ryosaitoh/Desktop/git/zmk/app/boards/shields/*/Kconfig.defconfig"
osource "/Users/ryosaitoh/Desktop/git/zmk-config-AroundFortyTB/config/boards/shields/*/Kconfig.defconfig"
```

## config/config/Kconfig
```kconfig
menu "AroundForty-TB configuration options"

config ZMK_SPLIT_POINTING
    bool "Forward pointing events between split halves"
    depends on ZMK_SPLIT && ZMK_POINTING
    help
      Enable support for forwarding pointing device reports between split
      halves. Set this to "y" on builds that need to share pointing data
      across the split link.

endmenu
```
